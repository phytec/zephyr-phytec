## boards/shields/phytec_ov5640/Kconfig.shield
```kconfig
# Copyright 2026 PHYTEC America LLC
# SPDX-License-Identifier: Apache-2.0

config SHIELD_PHYTEC_OV5640
	def_bool $(shields_list_contains,phytec_ov5640)
```
