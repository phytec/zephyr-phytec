## boards/phytec/phyboard_libra_stm32mp257f/Kconfig.stm32mp257f_libra
```kconfig
#  Copyright (C) 2026 PHYTEC Messtechnik GmbH
#  Authors: Hong-Ly Ky <h.ky@phytec.fr>
#            Christophe Parant <c.parant@phytec.fr>
#            Nicolas Raimundo <n.raimundo@phytec.fr>


 config BOARD_STM32MP257F_LIBRA
    select SOC_STM32MP257FXX_M33 if BOARD_STM32MP257F_LIBRA_STM32MP257FXX_M33
```

## boards/phytec/phyboard_libra_stm32mp257f/board.yml
```yaml
board:
  name: stm32mp257f_libra
  full_name: phyFLEX-STM32MP257F FPSC Libra RDK
  vendor: phytec
  socs:
    - name: stm32mp257fxx
```

## boards/phytec/phyboard_libra_stm32mp257f/stm32mp257f_libra_stm32mp257fxx_m33_defconfig
```kconfig
#  Copyright (C) 2026 PHYTEC Messtechnik GmbH
#  Authors: Hong-Ly Ky <h.ky@phytec.fr>
#           Christophe Parant <c.parant@phytec.fr>
#           Nicolas Raimundo <n.raimundo@phytec.fr>

# Enable MPU
CONFIG_ARM_MPU=y

# Enable HW stack protection
CONFIG_HW_STACK_PROTECTION=y

# Enable UART driver
CONFIG_SERIAL=y

# UART console
CONFIG_CONSOLE=y
CONFIG_UART_CONSOLE=y

CONFIG_REGULATOR_FIXED_INIT_PRIORITY=1

CONFIG_SHELL=y
```
