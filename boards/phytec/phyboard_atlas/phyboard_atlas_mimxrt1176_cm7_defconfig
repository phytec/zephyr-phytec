## boards/phytec/phyboard_atlas/phyboard_atlas_mimxrt1176_cm7_defconfig
```kconfig
#
# Copyright 2024, PHYTEC America, LLC
#
# SPDX-License-Identifier: Apache-2.0
#

CONFIG_CONSOLE=y
CONFIG_UART_CONSOLE=y
CONFIG_SERIAL=y
```

## drivers/led/Kconfig.lp5569
```kconfig
# Copyright (c) 2021 Phytec Messtechnik GmbH
# SPDX-License-Identifier: Apache-2.0

config LP5569
	bool "LP5569 LED driver"
	depends on I2C
	help
	  Enable LED driver for LP5569.

	  LP5562 LED driver has 9 channels. Each channel can drive up to 25.5 mA
	  per LED.
```

## drivers/sensor/ti_hdc/Kconfig
```kconfig
# TI_HDC temperature and humidity sensor configuration options

# Copyright (c) 2016 Intel Corporation
# SPDX-License-Identifier: Apache-2.0

config TI_HDC
	bool "Texas Instruments Temperature and Humidity Sensor (e.g. HDC1008)"
	default y
	depends on DT_HAS_TI_HDC_ENABLED
	select I2C
	help
	  Enable driver for TI temperature and humidity sensors.

config TI_HDC_INIT_PRIORITY
	int "Initialization priority"
	default 91
	help
	  Initialization priority for the TI HDC driver. This has to have a
	  higher value than other sensors because the TI_HDC device needs
	  10-15 ms to power up.
```

## dts/bindings/dac/nxp,kinetis-dac12.yaml
```yaml
# Copyright (c) 2025 PHYTEC America LLC
# SPDX-License-Identifier: Apache-2.0

description: NXP Kinetis MCUX DAC

compatible: "nxp,kinetis-dac12"

include: dac-controller.yaml

properties:
  reg:
    required: true

  voltage-reference:
    type: int
    required: true
    description: DAC voltage reference select

  buffered:
    type: boolean
    description: Enable output buffer

  "#io-channel-cells":
    const: 1

io-channel-cells:
  - output
```

## samples/modules/lvgl/demos/boards/phyboard_atlas_mimxrt1176_cm7.conf
```kconfig
# Copyright 2023 Fabian Blatz <fabianblatz@gmail.com>
# SPDX-License-Identifier: Apache-2.0

# Enable PXP DMA engine and set rotation angle to 0 degrees.
# This allows us to verify the DMA driver functions without altering
# the output image
CONFIG_DMA=y
CONFIG_MCUX_PXP=y
CONFIG_MCUX_ELCDIF_PXP=y
CONFIG_MCUX_ELCDIF_PXP_ROTATE_0=y

CONFIG_MAIN_STACK_SIZE=8192
CONFIG_LV_Z_MEM_POOL_SIZE=75264
```
