# MK64F12 register map
Vendor: Freescale Semiconductor, Inc.; Series: Kinetis_K; File version: 1.6
MK64F12 Freescale Microcontroller
CPU: CM4 r0p1, little endian, no MPU, FPU, VTOR, 4 interrupt priority bits
Registers are 32-bit, read-write, reset 0x0 unless marked. A register's access mark holds for its fields unless they carry their own. Offsets are from the block's base; lines under a group give offsets from that group; [hi:lo] are bit positions; {n}, {i} and the like mark numbered series; 'fields as' and 'values as' point back to an identical list; <NAME> marks a mode.

## Memory map
0x00000400 FTFE_FlashConfig size 0x10 — Flash configuration field
0x40000000 AIPS0 size 0x84 — AIPS-Lite Bridge
0x40004000 AXBS size 0xD04 — Crossbar switch
0x40008000 DMA size 0x1200 — Enhanced direct memory access controller
0x4000C000 FB size 0x64 — FlexBus external bus interface
0x4000D000 MPU size 0x830 — Memory protection unit
0x4001F000 FMC size 0x280 — Flash Memory Controller
0x40020000 FTFE size 0x18 — Flash Memory Interface
0x40021000 DMAMUX size 0x10 — DMA channel multiplexor
0x40024000 CAN0 size 0x8C0 — Flex Controller Area Network module
0x40029000 RNG size 0x10 — Random Number Generator Accelerator
0x4002C000 SPI0 size 0x8C — Serial Peripheral Interface
0x4002D000 SPI1 size 0x8C — Serial Peripheral Interface
0x4002F000 I2S0 size 0x108 — Inter-IC Sound / Synchronous Audio Interface
0x40032000 CRC size 0xC — Cyclic Redundancy Check
0x40035000 USBDCD size 0x1C — USB Device Charger Detection module
0x40036000 PDB0 size 0x1A0 — Programmable Delay Block
0x40037000 PIT size 0x140 — Periodic Interrupt Timer
0x40038000 FTM0 size 0x9C — FlexTimer Module
0x40039000 FTM1 size 0x9C — FlexTimer Module
0x4003A000 FTM2 size 0x9C — FlexTimer Module
0x4003B000 ADC0 size 0x70 — Analog-to-Digital Converter
0x4003D000 RTC size 0x808 — Secure Real Time Clock
0x4003E000 RFVBAT size 0x20 — VBAT register file
0x40040000 LPTMR0 size 0x10 — Low Power Timer
0x40041000 RFSYS size 0x20 — System register file
0x40047000 SIM size 0x1064 — System Integration Module
0x40049000 PORTA size 0xA4 — Pin Control and Interrupts
0x4004A000 PORTB size 0xA4 — Pin Control and Interrupts
0x4004B000 PORTC size 0xA4 — Pin Control and Interrupts
0x4004C000 PORTD size 0xCC — Pin Control and Interrupts
0x4004D000 PORTE size 0xA4 — Pin Control and Interrupts
0x40052000 WDOG size 0x18 — Generation 2008 Watchdog Timer
0x40061000 EWM size 0x4 — External Watchdog Monitor
0x40062000 CMT size 0xC — Carrier Modulator Transmitter
0x40064000 MCG size 0xE — Multipurpose Clock Generator module
0x40065000 OSC size 0x1 — Oscillator
0x40066000 I2C0 size 0xC — Inter-Integrated Circuit
0x40067000 I2C1 size 0xC — Inter-Integrated Circuit
0x4006A000 UART0 size 0x20 — Serial Communication Interface
0x4006B000 UART1 size 0x17 — Serial Communication Interface
0x4006C000 UART2 size 0x17 — Serial Communication Interface
0x4006D000 UART3 size 0x17 — Serial Communication Interface
0x40072000 USB0 size 0x15D — Universal Serial Bus, OTG Capable Controller
0x40073000 CMP0 size 0x6 — High-Speed Comparator (CMP), Voltage Reference (VREF) Digital-to-Analog Converter (DAC), and Analog Mux (ANMUX)
0x40073008 CMP1 size 0x6 — High-Speed Comparator (CMP), Voltage Reference (VREF) Digital-to-Analog Converter (DAC), and Analog Mux (ANMUX)
0x40073010 CMP2 size 0x6 — High-Speed Comparator (CMP), Voltage Reference (VREF) Digital-to-Analog Converter (DAC), and Analog Mux (ANMUX)
0x40074000 VREF size 0x2 — Voltage Reference
0x4007C000 LLWU size 0xB — Low leakage wakeup unit
0x4007D000 PMC size 0x3 — Power Management Controller
0x4007E000 SMC size 0x4 — System Mode Controller
0x4007F000 RCM size 0x8 — Reset Control Module
0x40080000 AIPS1 size 0x84 — AIPS-Lite Bridge
0x400AC000 SPI2 size 0x8C — Serial Peripheral Interface
0x400B1000 SDHC size 0x100 — Secured Digital Host Controller
0x400B9000 FTM3 size 0x9C — FlexTimer Module
0x400BB000 ADC1 size 0x70 — Analog-to-Digital Converter
0x400C0000 ENET blocks up to offset 0x628 — Ethernet MAC-NET Core
0x400CC000 DAC0 size 0x24 — 12-Bit Digital-to-Analog Converter
0x400CD000 DAC1 size 0x24 — 12-Bit Digital-to-Analog Converter
0x400E6000 I2C2 size 0xC — Inter-Integrated Circuit
0x400EA000 UART4 size 0x17 — Serial Communication Interface
0x400EB000 UART5 size 0x17 — Serial Communication Interface
0x400FF000 GPIOA size 0x18 — General Purpose Input/Output
0x400FF040 GPIOB size 0x18 — General Purpose Input/Output
0x400FF080 GPIOC size 0x18 — General Purpose Input/Output
0x400FF0C0 GPIOD size 0x18 — General Purpose Input/Output
0x400FF100 GPIOE size 0x18 — General Purpose Input/Output
0xE000E000 SystemControl blocks up to offset 0xF40 — System Control Block
0xE000E010 SysTick size 0x10 — System timer
0xE000E100 NVIC size 0xE04 — Nested Vectored Interrupt Controller
0xE0080000 MCM blocks up to offset 0x34 — Core Platform Miscellaneous Control Module
0xE0081000 CAU size 0xB6C — Memory Mapped Cryptographic Acceleration Unit (MMCAU)

## Interrupts
{n} DMA{n} (DMA) (n=0..15)
16 DMA_Error (DMA)
17 MCM
18 FTFE
19 Read_Collision (FTFE)
20 LVD_LVW (PMC)
21 LLWU
22 WDOG_EWM (WDOG, EWM)
23 RNG
24 I2C0
25 I2C1
26 SPI0
27 SPI1
28 I2S0_Tx (I2S0)
29 I2S0_Rx (I2S0)
30 UART0_LON (UART0)
31 UART0_RX_TX (UART0)
32 UART0_ERR (UART0)
33 UART1_RX_TX (UART1)
34 UART1_ERR (UART1)
35 UART2_RX_TX (UART2)
36 UART2_ERR (UART2)
37 UART3_RX_TX (UART3)
38 UART3_ERR (UART3)
39 ADC0
40 CMP0
41 CMP1
42 FTM0
43 FTM1
44 FTM2
45 CMT
46 RTC
47 RTC_Seconds (RTC)
48 PIT0 (PIT)
49 PIT1 (PIT)
50 PIT2 (PIT)
51 PIT3 (PIT)
52 PDB0
53 USB0
54 USBDCD
56 DAC0
58 LPTMR0
59 PORTA (PORTA, GPIOA)
60 PORTB (PORTB, GPIOB)
61 PORTC (PORTC, GPIOC)
62 PORTD (PORTD, GPIOD)
63 PORTE (PORTE, GPIOE)
65 SPI2
66 UART4_RX_TX (UART4)
67 UART4_ERR (UART4)
68 UART5_RX_TX (UART5)
69 UART5_ERR (UART5)
70 CMP2
71 FTM3
72 DAC1
73 ADC1
74 I2C2
75 CAN0_ORed_Message_buffer (CAN0)
76 CAN0_Bus_Off (CAN0)
77 CAN0_Error (CAN0)
78 CAN0_Tx_Warning (CAN0)
79 CAN0_Rx_Warning (CAN0)
80 CAN0_Wake_Up (CAN0)
81 SDHC
82 ENET_1588_Timer (ENET)
83 ENET_Transmit (ENET)
84 ENET_Receive (ENET)
85 ENET_Error (ENET)

## Licence text in the file
Redistribution and use in source and binary forms, with or without modification, are permitted provided that the following conditions are met: o Redistributions of source code must retain the above copyright notice, this list of conditions and the following disclaimer. o Redistributions in binary form must reproduce the above copyright notice, this list of conditions and the following disclaimer in the documentation and/or other materials provided with the distribution. o Neither the name of Freescale Semiconductor, Inc. nor the names of its contributors may be used to endorse or promote products derived from this software without specific prior written permission. THIS SOFTWARE IS PROVIDED BY THE COPYRIGHT HOLDERS AND CONTRIBUTORS "AS IS" AND. ANY EXPRESS OR IMPLIED WARRANTIES, INCLUDING, BUT NOT LIMITED TO, THE IMPLIED. WARRANTIES OF MERCHANTABILITY AND FITNESS FOR A PARTICULAR PURPOSE ARE. DISCLAIMED. IN NO EVENT SHALL THE COPYRIGHT HOLDER OR CONTRIBUTORS BE LIABLE FOR. ANY DIRECT, INDIRECT, INCIDENTAL, SPECIAL, EXEMPLARY, OR CONSEQUENTIAL DAMAGES (INCLUDING, BUT NOT LIMITED TO, PROCUREMENT OF SUBSTITUTE GOODS OR SERVICES; LOSS OF USE, DATA, OR PROFITS; OR BUSINESS INTERRUPTION) HOWEVER CAUSED AND ON. ANY THEORY OF LIABILITY, WHETHER IN CONTRACT, STRICT LIABILITY, OR TORT (INCLUDING NEGLIGENCE OR OTHERWISE) ARISING IN ANY WAY OUT OF THE USE OF THIS. SOFTWARE, EVEN IF ADVISED OF THE POSSIBILITY OF SUCH DAMAGE.
