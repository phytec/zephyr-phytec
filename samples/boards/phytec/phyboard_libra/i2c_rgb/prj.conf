## CMakeLists.txt
```
# SPDX-License-Identifier: Apache-2.0

cmake_minimum_required(VERSION 3.28.0)
find_package(Zephyr REQUIRED HINTS $ENV{ZEPHYR_BASE})
project(i2c_rgb)

FILE(GLOB app_sources src/*.c)
target_sources(app PRIVATE ${app_sources})
```

## prj.conf
```kconfig
# SPDX-FileCopyrightText: Copyright The Zephyr Project Contributors
# SPDX-License-Identifier: Apache-2.0

CONFIG_I2C=y
CONFIG_LED=y
```

## boards/stm32mp257f_libra_stm32mp257fxx_m33.overlay
```dts
/*
 * Copyright (C) 2025 PHYTEC Messtechnik GmbH
 * Authors: Hong-Ly Ky <h.ky@phytec.fr>
 *          Christophe Parant <c.parant@phytec.fr>
 *          Nicolas Raimundo <n.raimundo@phytec.fr>
 */
 
/delete-node/ &ddr_code;
/delete-node/ &ddr_sys;

/ {
   /* Remap to SRAM1 physical address */
   ddr_code: memory0@a043000 {
     reg = <0xa043000 0x1d000>;
     ranges = <0x0 0xa043000 0x1d000>;
     #address-cells = <1>;
     #size-cells = <1>;
   };

   /* Remap to RETRAM physical address */
   ddr_sys: memory1@a080000 {
     reg = <0xa080000 0x1f000>;
     ranges = <0x0 0xa080000 0x1f000>;
     #address-cells = <1>;
     #size-cells = <1>;
   };
};
```

## src/main.c
```c
#include <zephyr/kernel.h>
#include <zephyr/drivers/led.h>

#define RED_LED 0
#define GREEN_LED 1
#define BLUE_LED 2

int main(void){
    static const struct device *rgb = DEVICE_DT_GET(DT_ALIAS(rgb_led0));

    if (!device_is_ready(rgb)) {
		printf("PCA9633 not ready\n");
		return -1;
	}

    while(1){
        printf("ROUGE\n");

        led_set_brightness(rgb, RED_LED, 100);
        led_set_brightness(rgb, GREEN_LED, 0);
        led_set_brightness(rgb, BLUE_LED, 0);

        k_msleep(2000);

        printf("VERT\n");
        
        led_set_brightness(rgb, RED_LED, 0);
        led_set_brightness(rgb, GREEN_LED, 100);
        led_set_brightness(rgb, BLUE_LED, 0);

        k_msleep(2000);

        printf("BLEU\n");
        
        led_set_brightness(rgb, RED_LED, 0);
        led_set_brightness(rgb, GREEN_LED, 0);
        led_set_brightness(rgb, BLUE_LED, 100);

        k_msleep(2000);
    }

    return 0;
}
```
