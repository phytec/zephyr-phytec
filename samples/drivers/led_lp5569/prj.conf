## CMakeLists.txt
```
# SPDX-License-Identifier: Apache-2.0

cmake_minimum_required(VERSION 3.13.1)

find_package(Zephyr REQUIRED HINTS $ENV{ZEPHYR_BASE})
project(led_lp5569)

FILE(GLOB app_sources src/*.c)
target_sources(app PRIVATE ${app_sources})
```

## sample.yaml
```
sample:
  description: Demonstration of the LP5569 LED driver
  name: LP5569 sample
tests:
  sample.drivers.led.lp5569:
    platform_allow: frdm_kw41z
    tags: LED
```

## prj.conf
```kconfig
CONFIG_LOG=y
CONFIG_LED_LOG_LEVEL_DBG=y
CONFIG_I2C=y
CONFIG_LED=y
CONFIG_LP5569=y
```

## src/main.c
```c
/*
 * Copyright (c) 2021 Phytec Messtechnik GmbH
 *
 * SPDX-License-Identifier: Apache-2.0
 */

#include <device.h>
#include <errno.h>
#include <drivers/led.h>
#include <sys/util.h>
#include <zephyr.h>
#include <drivers/gpio.h>
#include <devicetree.h>

#define LOG_LEVEL CONFIG_LOG_DEFAULT_LEVEL
#include <logging/log.h>
LOG_MODULE_REGISTER(app);

#define LED_DEV_NAME DT_LABEL(DT_INST(0, ti_lp5569))
#define NUM_LEDS		8
#define MAX_BRIGHTNESS	254

#define DELAY_TIME		K_MSEC(4)
#define LED_ON_TIME		K_MSEC(2000)
#define LED_OFF_TIME	K_MSEC(2000)

void main(void)
{
	int i;
	const struct device *led_dev;
	uint8_t brightness;
	
	led_dev = device_get_binding(LED_DEV_NAME);
	if (led_dev) {
		LOG_INF("Found LED device %s", LED_DEV_NAME);
	} else {
		LOG_ERR("LED device %s not found", LED_DEV_NAME);
		return;
	}

	/*
	 * Display a continuous pattern that turns on 8 LEDs on one by
	 * one until it reaches the end and turns off LEDs in same order.
	 */
	LOG_INF("Displaying the pattern");

	while (1) {
		/* Turn on LEDs one by one */
		for (i = 0; i < NUM_LEDS; i++) {
			if (led_on(led_dev, i) != 0) {
				return;
			}
		}
		k_sleep(LED_ON_TIME);

		/* Turn off LEDs one by one */
		for (i = 0; i < NUM_LEDS; i++) {
			if (led_off(led_dev, i) != 0) {
				return;
			}
		}
		k_sleep(LED_OFF_TIME);
		
		/* Dim up all LEDs */
		for (brightness = 0; brightness < MAX_BRIGHTNESS; brightness++) {
			for (i = 0; i < NUM_LEDS; i++) {
				if (led_set_brightness(led_dev, i, brightness) != 0) {
					return;
				}
			}
			k_sleep(DELAY_TIME);
		}

		/* Dim down all LEDs */
		for (brightness = 0; brightness <= MAX_BRIGHTNESS; brightness++) {
			for (i = 0; i < NUM_LEDS; i++) {
				if (led_set_brightness(led_dev, i, MAX_BRIGHTNESS - brightness) != 0) {
					return;
				}
			}
			k_sleep(DELAY_TIME);
		}

		k_sleep(LED_OFF_TIME);
	}
}
```
